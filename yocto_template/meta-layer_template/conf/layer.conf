## yocto_template/meta-layer_template/conf/layer.conf
```bitbake
# We have a conf and classes directory, add to BBPATH
BBPATH .= ":${LAYERDIR}"

# We have recipes-* directories, add to BBFILES
BBFILES += "${LAYERDIR}/recipes-*/*/*.bb \
  ${LAYERDIR}/recipes-*/*/*.bbappend"

BBFILE_COLLECTIONS += "ota-connect"
BBFILE_PATTERN_ota-connect = "^${LAYERDIR}/"
BBFILE_PRIORITY_ota-connect = "6"

LAYERSERIES_COMPAT_ota-connect = "thud"
```
